## drivers/net/wireless/realtek/rtw88/Kconfig
```kconfig
# SPDX-License-Identifier: GPL-2.0-only
menuconfig RTW88
	tristate "Realtek 802.11ac wireless chips support"
	depends on MAC80211
	help
	  This module adds support for mac80211-based wireless drivers.

if RTW88

config RTW88_CORE
	tristate

config RTW88_USB
	tristate

config RTW88_8812A
	tristate

config RTW88_8812AU
	tristate "Realtek 8812AU USB wireless network adapter"
	depends on USB
	select RTW88_CORE
	select RTW88_USB
	select RTW88_8812A
	help
	  Select this option to support 8812AU USB devices.

config RTW88_8821A
	tristate

config RTW88_8821AU
	tristate "Realtek 8821AU USB wireless network adapter"
	depends on USB
	select RTW88_CORE
	select RTW88_USB
	select RTW88_8821A
	help
	  Select this option to support 8821AU USB devices.

config RTW88_DEBUG
	bool "Realtek rtw88 debug support"
	depends on RTW88_CORE
	default y

endif
```
